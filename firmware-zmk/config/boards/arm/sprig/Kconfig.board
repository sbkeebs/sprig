## firmware-zmk/config/boards/arm/sprig/Kconfig.board
```kconfig
# Le Chiffre (stm32) board configuration

# Copyright (c) 2020 The ZMK Contributors
# SPDX-License-Identifier: MIT

config BOARD_SPRIG
    bool "Sprig"
    depends on SOC_STM32F072XB
```

## firmware-zmk/config/boards/arm/sprig/Kconfig.defconfig
```kconfig
# Le Chiffre (stm32) board configuration

# Copyright (c) 2020 The ZMK Contributors
# SPDX-License-Identifier: MIT

if BOARD_SPRIG

config BOARD
    default "sprig"

config ZMK_KEYBOARD_NAME
    default "Sprig"

config ZMK_USB
    default y

config ZMK_KSCAN_MATRIX_POLLING
    default y

endif # BOARD_SPRIG
```
